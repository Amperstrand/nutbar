## esp32/atom-detector/sdkconfig.defaults
```kconfig
# Minimal config for M5StickC Plus (ESP32-PICO-D4)
CONFIG_IDF_TARGET="esp32"
CONFIG_ESPTOOLPY_FLASHSIZE_4MB=y
CONFIG_ESPTOOLPY_FLASHMODE_DIO=y
CONFIG_ESPTOOLPY_FLASHFREQ_40M=y
CONFIG_PARTITION_TABLE_SINGLE_APP=y
CONFIG_FREERTOS_HZ=1000
CONFIG_ESP_MAIN_TASK_STACK_SIZE=8192
CONFIG_ESP_HTTP_CLIENT_ENABLE_HTTPS=n
CONFIG_LWIP_MAX_SOCKETS=8
```
